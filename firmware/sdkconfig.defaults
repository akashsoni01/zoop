## firmware/sdkconfig.defaults
```kconfig
# ESP32-S3 defaults for Zoop — Waveshare ESP32-S3-ePaper-1.54

CONFIG_IDF_TARGET="esp32s3"
CONFIG_ESP_DEFAULT_CPU_FREQ_MHZ_240=y
CONFIG_ESP_MAIN_TASK_STACK_SIZE=8192

# PSRAM (board has OPI PSRAM)
CONFIG_SPIRAM=y
CONFIG_SPIRAM_MODE_OCT=y
CONFIG_SPIRAM_SPEED_80M=y

# Logging
CONFIG_LOG_DEFAULT_LEVEL_INFO=y

# FreeRTOS
CONFIG_FREERTOS_HZ=1000

# WiFi
CONFIG_ESP_WIFI_STATIC_RX_BUFFER_NUM=10
CONFIG_ESP_WIFI_DYNAMIC_RX_BUFFER_NUM=32

# FAT / SD
CONFIG_FATFS_LFN_HEAP=y

# Deep sleep wake on GPIO
CONFIG_ESP_SLEEP_GPIO_RESET_WORKAROUND=y
```
